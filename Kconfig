## Kconfig
```kconfig
# Copyright (c) 2021-2022 Amlogic, Inc. All rights reserved.

# SPDX-License-Identifier: MIT

menu "RISCV Options"

config RISCV
	bool
	select KERNEL
	help
	  RISC-V architecture

endmenu
```
